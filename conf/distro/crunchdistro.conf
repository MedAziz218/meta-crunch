## conf/distro/crunchdistro.conf
```bitbake
# Inherit from the Poky distribution
DISTRO = "crunchdistro"
DISTRO_NAME = "Crunch Custom Distro"
DISTRO_VERSION = "1.0"
DISTRO_DESCRIPTION = "Custom Yocto distribution based on Poky with Systemd and Deb packages"

# Set the init system to systemd
INIT_MANAGER = "systemd"
# PREFERRED_VERSION_python3 = "3.10.6"

# Set the package manager to use deb packages
PACKAGE_CLASSES = "package_deb"
LICENSE = "MIT"

# Enable systemd to handle init
DISTRO_FEATURES:append = " systemd"
DISTRO_FEATURES_BACKFILL_CONSIDERED += "sysvinit"
VIRTUAL-RUNTIME_init_manager = "systemd"
VIRTUAL-RUNTIME_initscripts = "systemd-compat-units"

# use systemd-journald as your sole logging mechanism
VIRTUAL-RUNTIME_syslog = ""
VIRTUAL-RUNTIME_base-utils-syslog = ""

# Ensure systemd services are included in the image
# EXTRA_IMAGE_FEATURES += "systemd"

require conf/distro/include/no-static-libs.inc
require conf/distro/include/yocto-uninative.inc
require conf/distro/include/security_flags.inc
INHERIT += "uninative"

# # Specify additional settings like user space configuration (optional)
# IMAGE_INSTALL_append = " systemd-compat-units"
```
